## configs/busybox/defconfig
```kconfig
CONFIG_STATIC=y
CONFIG_FEATURE_SH_STANDALONE=y
CONFIG_ASH=y
CONFIG_SH_IS_ASH=y
CONFIG_CAT=y
CONFIG_ECHO=y
CONFIG_LS=y
CONFIG_MOUNT=y
CONFIG_UMOUNT=y
CONFIG_DMESG=y
CONFIG_UNAME=y
CONFIG_POWEROFF=y
CONFIG_REBOOT=y
CONFIG_HALT=y
CONFIG_TC=n
CONFIG_FEATURE_TC_INGRESS=n
CONFIG_FEATURE_IP_RARE_PROTOCOLS=n
```

## configs/linux/defconfig
```kconfig
CONFIG_64BIT=y
CONFIG_ARM64=y
CONFIG_ARCH_VIRT=y
CONFIG_SERIAL_AMBA_PL011=y
CONFIG_SERIAL_AMBA_PL011_CONSOLE=y
CONFIG_VIRTIO=y
CONFIG_VIRTIO_MMIO=y
CONFIG_BLK_DEV_INITRD=y
CONFIG_INITRAMFS_SOURCE=""
CONFIG_DEVTMPFS=y
CONFIG_DEVTMPFS_MOUNT=y
CONFIG_TMPFS=y
CONFIG_PRINTK=y
CONFIG_EARLY_PRINTK=y
CONFIG_DEBUG_INFO=n
```
